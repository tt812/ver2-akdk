## boards/shields/ver2/Kconfig.defconfig
```kconfig
if SHIELD_VER2_RIGHT

config ZMK_KEYBOARD_NAME
    default "ver2"

endif

if SHIELD_VER2_LEFT || SHIELD_VER2_RIGHT

config ZMK_SPLIT
    default y

endif
```

## boards/shields/ver2/Kconfig.shield
```kconfig
config SHIELD_VER2_LEFT
    def_bool $(shields_list_contains,ver2_left)
config SHIELD_VER2_RIGHT
    def_bool $(shields_list_contains,ver2_right)
```
